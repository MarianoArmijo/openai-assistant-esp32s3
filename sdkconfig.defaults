## sdkconfig.defaults
```kconfig
# ESP Event Loop on Linux
CONFIG_ESP_EVENT_POST_FROM_ISR=n
CONFIG_ESP_EVENT_POST_FROM_IRAM_ISR=n

# Disable TLS verification
# Production needs to include specific cert chain you care about
CONFIG_ESP_TLS_INSECURE=y
CONFIG_ESP_TLS_SKIP_SERVER_CERT_VERIFY=y

# Enable DTLS-SRTP
CONFIG_MBEDTLS_SSL_PROTO_DTLS=y

# libpeer requires large stack allocations
CONFIG_ESP_MAIN_TASK_STACK_SIZE=16384

# Defaults to partitions.csv
CONFIG_PARTITION_TABLE_CUSTOM=y

# Set highest CPU Freq
CONFIG_ESP_DEFAULT_CPU_FREQ_MHZ_240=y

CONFIG_SPIRAM=y
CONFIG_SPIRAM_MODE_OCT=y

# Disable Watchdog
# CONFIG_ESP_INT_WDT is not set
# CONFIG_ESP_TASK_WDT_EN is not set

# Enable Compiler Optimization
CONFIG_COMPILER_OPTIMIZATION_PERF=y
CONFIG_COMPILER_OPTIMIZATION_ASSERTIONS_DISABLE=y

# 16 MB flash (Freenove ESP32-S3-WROOM)
CONFIG_ESPTOOLPY_FLASHSIZE_16MB=y

# ESP-SR: Multinet7 English (used to register custom "suku" command)
CONFIG_SR_MN_CN_NONE=y
CONFIG_SR_MN_EN_MULTINET7_QUANT=y
CONFIG_SR_NSN_WEBRTC=y
CONFIG_SR_VADN_WEBRTC=y
```
